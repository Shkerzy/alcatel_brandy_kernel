## drivers/i2c/chips/Kconfig
```kconfig
#
# Miscellaneous I2C chip drivers configuration
#
# *** DEPRECATED! Do not add new entries! See Makefile ***
#

menu "Miscellaneous I2C Chip support"

config SENSORS_MT9T013
	tristate "MT9T013 Camera Driver"
	depends on I2C
	default y
	help
	 MT9T013 Camera Driver implemented by HTC.

config SENSORS_AKM8975
	tristate "AKM8975 Compass Driver"
	depends on I2C_GPIO
	help
	  AKM8975 Compass Driver implemented by ALCATEL.

endmenu
```
